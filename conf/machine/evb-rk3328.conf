## conf/machine/evb-rk3328.conf
```bitbake
# Copyright (C) 2017 Fuzhou Rockchip Electronics Co., Ltd
# Released under the MIT license (see COPYING.MIT for the terms)

#@TYPE: Machine
#@NAME: EVB 3399

include conf/machine/include/rk3328.inc

KERNEL_DEVICETREE = "rockchip/rk3328-evb.dtb"
UBOOT_MACHINE = "evb-rk3328_defconfig"

GPTIMG_APPEND = "earlycon=uart8250,mmio32,0xff130000 rw root=/dev/mmcblk2p7 rootwait rootfstype=ext4 init=/sbin/init rootwait"
```

## conf/machine/include/rk3399.inc
```bitbake
# Copyright (C) 2017 Jacob Chen
# Released under the MIT license (see COPYING.MIT for the terms)

SOC_FAMILY = "rk3399"

require conf/machine/include/arm/arch-armv8.inc
require conf/machine/include/soc-family.inc

PREFERRED_PROVIDER_virtual/kernel = "linux-mainline"

SERIAL_CONSOLES = "1500000;ttyFIQ0"
KERNEL_IMAGETYPE = "Image"
KBUILD_DEFCONFIG = "defconfig"

PREFERRED_PROVIDER_virtual/bootloader ?= "u-boot-rockchip"

IMAGE_FSTYPES = "ext4 rockchip-gpt-img"
IMAGE_CLASSES += "rockchip-gpt-img rockchip-update-img"
```
